/* GENERATED NO-OP PERIPHERAL MOCKS, NOT hardware emulation. */
void      AD5940_ADCMuxCfgS(uint32_t ADCMuxP, uint32_t ADCMuxN) {}
void      AD5940_AFECtrlS(uint32_t AfeCtrlSet, BoolFlag State) {}
void      AD5940_AFEPwrBW(uint32_t AfePwr, uint32_t AfeBw) {}
void      AD5940_AGPIOCfg(AGPIOCfg_Type *pAgpioCfg) {}
void      AD5940_CLKCfg(CLKCfg_Type *pClkCfg) {}
void      AD5940_DSPCfgS(DSPCfg_Type *pDSPCfg) {}
void      AD5940_EnterSleepS(void) {}
void      AD5940_FIFOCfg(FIFOCfg_Type *pFifoCfg) {}
void      AD5940_FIFOCtrlS(uint32_t FifoSrc, BoolFlag FifoEn) {}
void      AD5940_HSLoopCfgS(HSLoopCfg_Type *pHsLoopCfg) {}
void      AD5940_HWReset(void) {}
void      AD5940_INTCCfg(uint32_t AfeIntcSel, uint32_t AFEIntSrc, BoolFlag State) {}
void      AD5940_INTCClrFlag(uint32_t AfeIntSrcSel) {}
void      AD5940_Initialize(void) {}
void      AD5940_LPLoopCfgS(LPLoopCfg_Type *pLpLoopCfg) {}
void      AD5940_REFCfgS(AFERefCfg_Type *pBufCfg) {}
void      AD5940_SEQCfg(SEQCfg_Type *pSeqCfg) {}
void      AD5940_SEQCmdWrite(uint32_t StartAddr, const uint32_t *pCommand, uint32_t CmdCnt) {}
void      AD5940_SEQCtrlS(BoolFlag SeqEn) {}
void      AD5940_SEQGenInit(uint32_t *pBuffer, uint32_t BufferSize) {}
void      AD5940_SEQGenInsert(uint32_t CmdWord) {}
void      AD5940_SEQGpioCtrlS(uint32_t GpioSet) {}
void      AD5940_SEQInfoCfg(SEQInfo_Type *pSeq) {}
void      AD5940_SEQMmrTrig(uint32_t SeqId) {}
void      AD5940_SWMatrixCfgS(SWMatrixCfg_Type *pSwMatrix) {}
void      AD5940_WGFreqCtrlS(float SinFreqHz, float WGClock) {}
void      AD5940_WUPTCfg(WUPTCfg_Type *pWuptCfg) {}
void      AD5940_WriteReg(uint16_t RegAddr, uint32_t RegData) {}
